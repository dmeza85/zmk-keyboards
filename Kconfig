## Kconfig
```kconfig
config IMPRINT_RGB_LAYER_COLORS
    bool "Per-layer RGB underglow color indicator"
    default y
    depends on ZMK_RGB_UNDERGLOW
    help
      Sets the underglow color to a distinct value based on the highest
      currently active keymap layer.

config ZMK_STUDIO_UNLOCK_COMBO
    bool "Keymap-independent unlock key combo"
    default y
    depends on ZMK_STUDIO_LOCKING
    help
      Unlock ZMK Studio by holding a fixed set of physical keys (defined
      in devicetree by matrix row/column, see boards/shields/imprint/imprint.dtsi)
      for a configured duration, without requiring a &studio_unlock binding
      in the keymap.
```

## config/west.yml
```yaml
manifest:
  remotes:
    - name: zmkfirmware
      url-base: https://github.com/zmkfirmware
    - name: badjeff
      url-base: https://github.com/badjeff
    - name: Cyboard-DigitalTailor
      url-base: https://github.com/Cyboard-DigitalTailor
  projects:
    - name: zmk
      remote: zmkfirmware
      revision: 9ebbeff0a8b69a42f14aec022cdf16c7a107b9e0
      import: app/west.yml
    - name: zmk-pmw3610-driver
      remote: Cyboard-DigitalTailor
      revision: startup_optimization
  self:
    path: config
```

## dts/bindings/behaviors/zmk,behavior-rgb-idle-timeout.yaml
```yaml
description: RGB Idle Timeout Adjust

compatible: "zmk,behavior-rgb-idle-timeout"

include: one_param.yaml
```
